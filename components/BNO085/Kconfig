## components/BNO085/Kconfig
```kconfig
menu "BNO085 Configuration"

	config SPI_MOSI_GPIO
	int "SPI MOSI GPIO pin"
	default 9

	config SPI_MISO_GPIO
	int "SPI MISO GPIO pin"
	default 8

	config SPI_SCK_GPIO
	int "SPI SCK GPIO pin"
	default 7

	config BNO085_INTERRUPT_GPIO
	int "BNO085 interrupt GPIO pin"
	default 2

	config BNO085_WAKE_GPIO
	int "Wake GPIO pin"
	default 44

	config BNO085_CSN_GPIO
	int "SPI CSN GPIO pin"
	default 3

	config BNO085_RESET_GPIO
	int "SPI reset GPIO pin"
	default 43

	config BNO085_REQUEST_TIMEOUT_MS
	int "I2C request timeout in milliseconds"
	default 100

endmenu
```

## main/Kconfig.projbuild
```kconfig
menu "GPIO configuration"
	config LED_GPIO
	int "GPIO pin"
	default 9

	config ONBOARD_LED_GPIO
	int "Onboard GPIO pin"
	default 21

	config I2C_SDA_GPIO
	int "I2C SDA GPIO pin"
	default 5

	config I2C_SCL_GPIO
	int "I2C SCL GPIO pin"
	default 6

	config SPI_MOSI_GPIO
	int "SPI MOSI GPIO pin"
	default 9

	config SPI_MISO_GPIO
	int "SPI MISO GPIO pin"
	default 8

	config SPI_SCK_GPIO
	int "SPI SCK GPIO pin"
	default 7
endmenu
```
